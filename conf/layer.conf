## conf/layer.conf
```bitbake
# We have a conf and classes directory, add to BBPATH
BBPATH .= ":${LAYERDIR}"

# We have recipes-* directories, add to BBFILES
BBFILES += "${LAYERDIR}/recipes-*/*/*.bb \
            ${LAYERDIR}/recipes-*/*/*.bbappend"

BBFILE_COLLECTIONS += "meta-custom-uart"
BBFILE_PATTERN_meta-custom-uart = "^${LAYERDIR}/"
BBFILE_PRIORITY_meta-custom-uart = "6"

LAYERDEPENDS_meta-custom-uart = "core"
LAYERSERIES_COMPAT_meta-custom-uart = "mickledore scarthgap"
```
